## Documentation/devicetree/bindings/auxdisplay/oel9m1027.txt
```
Binding for OEL9M1027 OLED display module manufactured by Truly

Required properties:
  - compatible : Compatibility string. Must be "truly,oel9m1027".

Example:

	oleddriver@3C {
		compatible = "sinowealth,sh1107";
		reg = <0x3C>;

		oledmodule {
			compatible = "truly,oel9m1027";
		};
	};
```

## Documentation/devicetree/bindings/auxdisplay/sh1107.txt
```
Binding for Sinowealth OLED driver

Required properties:
  - compatible: Compatibility string. Must be "sinowealth,sh1107".
  - reg : i2c address of Truly OLED module (0x3C or 0x3D)

Example:

	oleddriver@3C {
		compatible = "sinowealth,sh1107";
		reg = <0x3C>;
	};
```

## Documentation/devicetree/bindings/leds/leds-ni793x.txt
```
LEDs connected to NI-793xR

Required properties:
- compatible : should be : "ni,led-793x".
- reg: base address of LED control register space.

The ni,led-793x device node only contains a single sub-node, 'user1'.

LED sub-node properties:
- label : (optional) see leds/common.txt
- linux,default-trigger : (optional) see leds/common.txt

Examples:

leds-ni793x@4020F000 {
        compatible = "ni,led-793x";
        reg = <0x4020F000 4>;
        user1 {
                label = "nilrt:user1:green";
        };
};
```

## Documentation/devicetree/bindings/misc/ni,cpld.txt
```
National Instruments CPLD

National Instruments (NI) boards often have CPLDs on them to handle
board-specific tasks like LED control, board switches and buttons,
power sequencing, and CPU-independent watchdogs.

NI's CPLDs are connected over i2c. As such, 'nicpld' must be a child
of an i2c node.

nicpld properties:
- compatible : (required)
  Should be "ni,cpld"
- reg: (required)
  Address of the CPLD on the i2c bus

Required sub-nodes:
- watchdogs : A node containing sub-nodes describing watchdogs

Optional sub-nodes:
- switches : A node containing sub-nodes describing switches
- leds : A node containing sub-nodes describing LEDs


Watchdogs Child Node
====================

Each watchdog controlled by the CPLD is represented as a sub-node of
the nicpld's 'watchdogs' node. Each sub-node of 'watchdogs' has the
following properties.

Required properties:
- interrupts : Should be the CPLD watchdog interrupt specifier

Optional properties:
- label: A name for the CPLD switch


Switches Child Node
===================

Each switch or button controlled by the CPLD is represented as a
sub-node of the nicpld's 'switches' node. Each sub-node of 'switches'
has the following properties.

Required properties:
- interrupts : The CPLD switch interrupt specifier


LEDs Child Node
===============

Each LED controlled by the CPLD is represented as a sub-node of the
nicpld's 'leds' node.  The name of each LED node corresponds to an
LED type. The "-0" or "-1" suffixes specify an LED element (single
color) within a multi-color LED.

Possible LED types:
- user1-0
- user1-1
- status-0
- status-1
- temp-alert-0
- wifi-0
- wifi-1
- eth0-0
- eth0-1
- eth1-0
- eth1-1

Different CPLDs support different LED types. The set of LEDs that
various CPLDs support can be determined by examining their product
code. The product code for a CPLD can be determined by reading the
"NICPLD_PRODUCT" (0x1D) register of the CPLD over i2c. Below is a
list of which CPLDs support which LED types.

CPLD Products 0x00 and 0x01
---------------------------
user1-0
user1-1
status-0
status-1
wifi-0
wifi-1
eth0-0
eth0-1
eth1-0
eth1-1

CPLD Product 0x02
-----------------
status-0
temp-alert-0
eth0-0
eth0-1
eth1-0
eth1-1

CPLD Products 0x03 and 0x04
---------------------------
user1-0
status-0
eth0-0
eth0-1
eth1-0
eth1-1


LED sub-node properties:
- label :  (optional)
  see bindings/leds/common.txt
- max-brightness : (optional)
  The number of possible special blinking patterns. Selecting a
  brightness will pick the blink pattern.
- linux,default-trigger :  (optional)
  see bindings/leds/common.txt

Example:

nicpld@40 {
	compatible = "ni,cpld";
	reg = <0x40>;

	watchdogs {
		boot-watchdog {
			interrupt-parent = <&gpio>;
			interrupts = <24 0>;
		};
	};

	switches {
		wifi-switch {
			interrupt-parent = <&gpio>;
			interrupts = <25 0>;
		};
	};

	leds {
		user1-0 {
			label = "nilrt:user1:green";
		};
		status-0 {
			label = "nilrt:status:yellow";
			max-brightness = <0xFFFF>;
		};
		eth0-0 {
			label = "nilrt:eth0:green";
			linux,default-trigger =
				"e000b000.etherne:00:100Mb";
		};
		eth0-1 {
			label = "nilrt:eth0:yellow";
			linux,default-trigger =
				"e000b000.etherne:00:Gb";
		};
	};
};
```

## Documentation/devicetree/bindings/net/wireless/ti-wilink.txt
```
TI WiLink Wireless Modules Device Tree Bindings
===============================================

The WiLink modules provide wireless connectivity, such as WLAN,
Bluetooth, FM and NFC.

There are several different modules available, which can be grouped by
their generation: WiLink6, WiLink7 and WiLink8.  WiLink4 is not
currently supported with device tree.

Currently, only the WLAN portion of the modules is supported with
device tree.

Required properties:
--------------------

- compatible: should be "ti,wilink6", "ti,wilink7" or "ti,wilink8"
- interrupt-parent: the interrupt controller
- interrupts: out-of-band WLAN interrupt
	See the interrupt controller's bindings documentation for
	detailed definition.

Optional properties:
--------------------

- refclock: the internal WLAN reference clock frequency (required for
  WiLink6 and WiLink7; not used for WiLink8).  Must be one of the
  following:
	0 = 19.2 MHz
	1 = 26.0 MHz
	2 = 38.4 MHz
	3 = 52.0 MHz
	4 = 38.4 MHz, XTAL
	5 = 26.0 MHz, XTAL

- tcxoclock: the internal WLAN TCXO clock frequency (required for
  WiLink7 not used for WiLink6 and WiLink8).  Must be one of the
  following:
	0 = 19.200 MHz
	1 = 26.000 MHz
	2 = 38.400 MHz
	3 = 52.000 MHz
	4 = 16.368 MHz
	5 = 32.736 MHz
	6 = 16.800 MHz
	7 = 33.600 MHz
```

## Documentation/devicetree/bindings/serial/ni,ni16550.yaml
```yaml
# SPDX-License-Identifier: (GPL-2.0 OR BSD-2-Clause)
%YAML 1.2
---
$id: http://devicetree.org/schemas/serial/ni,ni16550.yaml#
$schema: http://devicetree.org/meta-schemas/core.yaml#

title: NI 16550 asynchronous serial interface (UART)

maintainers:
  - Brenda Streiff <brenda.streiff@ni.com>

allOf:
  - $ref: serial.yaml#

properties:
  compatible:
    const: ni,ni16550

  reg:
    maxItems: 1

  interrupts:
    maxItems: 1

  clocks:
    maxItems: 1

  ni,serial-port-mode:
    description: Indicates whether this is an RS-232 or RS-485 serial port.
    $ref: /schemas/types.yaml#/definitions/string
    enum: [ RS-232, RS-485 ]
    default: RS-485

required:
  - compatible
  - reg
  - interrupts

unevaluatedProperties: false

examples:
  - |
    #include <dt-bindings/interrupt-controller/irq.h>
    serial@80000000 {
      compatible = "ni,ni16550";
      reg = <0x80000000 0x8>;
      interrupts = <0 30 IRQ_TYPE_LEVEL_HIGH>;
      clocks = <&clk_uart>;
      ni,serial-port-mode = "RS-232";
    };
...
```

## arch/arm/configs/nati_bluefin_defconfig
```kconfig
CONFIG_LOCALVERSION="-ni"
CONFIG_SYSVIPC=y
CONFIG_AUDIT=y
CONFIG_HIGH_RES_TIMERS=y
CONFIG_IKCONFIG=y
CONFIG_IKCONFIG_PROC=y
CONFIG_LOG_BUF_SHIFT=14
CONFIG_CGROUPS=y
CONFIG_CPUSETS=y
# CONFIG_PROC_PID_CPUSET is not set
CONFIG_CGROUP_CPUACCT=y
CONFIG_BLK_DEV_INITRD=y
CONFIG_CC_OPTIMIZE_FOR_SIZE=y
CONFIG_PERF_EVENTS=y
CONFIG_ARCH_ZYNQ=y
CONFIG_ARM_ERRATA_754322=y
CONFIG_ARM_ERRATA_764369=y
CONFIG_ARM_ERRATA_775420=y
CONFIG_SMP=y
CONFIG_SCHED_MC=y
CONFIG_SCHED_SMT=y
CONFIG_HIGHMEM=y
CONFIG_CMDLINE="console=ttyPS0,115200n8 root=/dev/ram rw initrd=0x00800000,16M earlyprintk mtdparts=physmap-flash.0:512K(nor-fsbl),512K(nor-u-boot),5M(nor-linux),9M(nor-user),1M(nor-scratch),-(nor-rootfs)"
CONFIG_VFP=y
CONFIG_NEON=y
# CONFIG_SUSPEND is not set
CONFIG_MODULES=y
CONFIG_MODULE_UNLOAD=y
CONFIG_MODULE_FORCE_UNLOAD=y
CONFIG_MODVERSIONS=y
# CONFIG_CORE_DUMP_DEFAULT_ELF_HEADERS is not set
# CONFIG_COMPACTION is not set
CONFIG_CMA=y
CONFIG_NET=y
CONFIG_PACKET=y
CONFIG_UNIX=y
CONFIG_INET=y
CONFIG_IP_MULTICAST=y
CONFIG_IP_ADVANCED_ROUTER=y
CONFIG_IP_MULTIPLE_TABLES=y
CONFIG_IP_ROUTE_MULTIPATH=y
CONFIG_IP_ROUTE_VERBOSE=y
CONFIG_IP_PNP=y
CONFIG_IP_PNP_DHCP=y
CONFIG_IP_PNP_BOOTP=y
CONFIG_IP_PNP_RARP=y
CONFIG_IP_MROUTE=y
CONFIG_IP_MROUTE_MULTIPLE_TABLES=y
CONFIG_IP_PIMSM_V1=y
CONFIG_IP_PIMSM_V2=y
# CONFIG_IPV6_SIT is not set
CONFIG_NETFILTER=y
CONFIG_BRIDGE_NETFILTER=y
CONFIG_NETFILTER_XT_MARK=y
CONFIG_IP_NF_IPTABLES=y
CONFIG_IP_NF_FILTER=y
CONFIG_BRIDGE_NF_EBTABLES=y
CONFIG_BRIDGE_EBT_T_FILTER=y
CONFIG_BRIDGE_EBT_MARK_T=y
CONFIG_BRIDGE=y
CONFIG_BRIDGE_VLAN_FILTERING=y
CONFIG_NET_DSA=y
CONFIG_VLAN_8021Q=y
CONFIG_NET_SCHED=y
CONFIG_DEVTMPFS=y
CONFIG_DEVTMPFS_MOUNT=y
CONFIG_CONNECTOR=y
CONFIG_MTD=y
CONFIG_MTD_CMDLINE_PARTS=y
CONFIG_MTD_BLOCK=y
CONFIG_MTD_CFI=y
CONFIG_MTD_CFI_AMDSTD=y
CONFIG_MTD_PHYSMAP=y
CONFIG_MTD_PHYSMAP_OF=y
CONFIG_MTD_UBI=y
CONFIG_MTD_UBI_GLUEBI=y
CONFIG_BLK_DEV_LOOP=y
CONFIG_BLK_DEV_RAM=y
CONFIG_BLK_DEV_RAM_SIZE=16384
CONFIG_SRAM=y
CONFIG_EEPROM_AT24=y
CONFIG_EEPROM_AT25=y
CONFIG_SCSI=y
CONFIG_BLK_DEV_SD=y
CONFIG_CHR_DEV_SG=y
# CONFIG_BLK_DEV_BSG is not set
CONFIG_NETDEVICES=y
CONFIG_BONDING=y
CONFIG_TUN=y
CONFIG_MACB=y
# CONFIG_NET_VENDOR_CIRRUS is not set
# CONFIG_NET_VENDOR_FARADAY is not set
# CONFIG_NET_VENDOR_HISILICON is not set
# CONFIG_NET_VENDOR_MARVELL is not set
# CONFIG_NET_VENDOR_MICREL is not set
# CONFIG_NET_VENDOR_MICROCHIP is not set
# CONFIG_NET_VENDOR_NATSEMI is not set
# CONFIG_NET_VENDOR_QUALCOMM is not set
# CONFIG_NET_VENDOR_SAMSUNG is not set
# CONFIG_NET_VENDOR_SEEQ is not set
# CONFIG_NET_VENDOR_SMSC is not set
# CONFIG_NET_VENDOR_STMICRO is not set
# CONFIG_NET_VENDOR_WIZNET is not set
# CONFIG_NET_VENDOR_XILINX is not set
CONFIG_LED_TRIGGER_PHY=y
CONFIG_MARVELL_PHY=y
CONFIG_MICREL_PHY=y
CONFIG_SMSC_PHY=y
CONFIG_VITESSE_PHY=y
CONFIG_MDIO_BITBANG=y
CONFIG_INPUT_SPARSEKMAP=y
CONFIG_INPUT_EVDEV=y
CONFIG_KEYBOARD_GPIO=y
# CONFIG_INPUT_MOUSE is not set
CONFIG_SERIAL_8250=y
# CONFIG_SERIAL_8250_DEPRECATED_OPTIONS is not set
CONFIG_SERIAL_8250_CONSOLE=y
CONFIG_SERIAL_8250_NR_UARTS=9
CONFIG_SERIAL_OF_PLATFORM=y
CONFIG_SERIAL_XILINX_PS_UART=y
CONFIG_SERIAL_XILINX_PS_UART_CONSOLE=y
# CONFIG_HW_RANDOM is not set
CONFIG_I2C=y
CONFIG_I2C_CHARDEV=y
CONFIG_I2C_CADENCE=y
CONFIG_I2C_XILINX=y
CONFIG_SPI=y
CONFIG_SPI_CADENCE=y
CONFIG_SPI_SPIDEV=y
CONFIG_GPIOLIB=y
CONFIG_GPIO_ZYNQ=y
CONFIG_POWER_RESET=y
CONFIG_POWER_RESET_GPIO_RESTART=y
CONFIG_POWER_SUPPLY=y
CONFIG_SENSORS_LM90=y
CONFIG_WATCHDOG=y
CONFIG_WATCHDOG_NOWAYOUT=y
CONFIG_CADENCE_WATCHDOG=y
CONFIG_FB=y
CONFIG_FRAMEBUFFER_CONSOLE=y
CONFIG_USB=y
CONFIG_USB_DYNAMIC_MINORS=y
CONFIG_USB_EHCI_HCD=y
CONFIG_USB_STORAGE=y
CONFIG_USB_CHIPIDEA=y
CONFIG_USB_CHIPIDEA_HOST=y
CONFIG_NOP_USB_XCEIV=y
CONFIG_USB_ULPI=y
CONFIG_MMC=y
CONFIG_MMC_SDHCI=y
CONFIG_MMC_SDHCI_PLTFM=y
CONFIG_MMC_SDHCI_OF_ARASAN=y
CONFIG_NEW_LEDS=y
CONFIG_LEDS_CLASS=y
CONFIG_LEDS_GPIO=y
CONFIG_LEDS_TRIGGERS=y
CONFIG_LEDS_TRIGGER_TIMER=y
CONFIG_LEDS_TRIGGER_ONESHOT=y
CONFIG_LEDS_TRIGGER_HEARTBEAT=y
CONFIG_LEDS_TRIGGER_DEFAULT_ON=y
CONFIG_RTC_CLASS=y
CONFIG_RTC_DRV_PCF8563=y
CONFIG_RTC_DRV_DS3232=y
CONFIG_DMADEVICES=y
CONFIG_PL330_DMA=y
CONFIG_COMMON_CLK_SI5351=y
CONFIG_COMMON_CLK_SI570=y
CONFIG_MEMORY=y
CONFIG_OVERLAY_FS=y
CONFIG_MSDOS_FS=y
CONFIG_VFAT_FS=y
CONFIG_TMPFS=y
CONFIG_TMPFS_POSIX_ACL=y
CONFIG_UBIFS_FS=y
CONFIG_SQUASHFS=y
CONFIG_SQUASHFS_XATTR=y
CONFIG_SQUASHFS_LZ4=y
CONFIG_SQUASHFS_LZO=y
CONFIG_SQUASHFS_XZ=y
CONFIG_NFS_FS=y
CONFIG_ROOT_NFS=y
CONFIG_CIFS=y
CONFIG_NLS_CODEPAGE_437=y
CONFIG_NLS_ASCII=y
CONFIG_NLS_ISO8859_1=y
CONFIG_SECURITY=y
CONFIG_SECURITY_NETWORK=y
CONFIG_SECURITY_SELINUX=y
CONFIG_SECURITY_SELINUX_BOOTPARAM=y
# CONFIG_INTEGRITY is not set
CONFIG_DEFAULT_SECURITY_DAC=y
CONFIG_CRYPTO_ANSI_CPRNG=y
CONFIG_CRYPTO_SHA1_ARM=y
CONFIG_CRYPTO_SHA256_ARM=y
CONFIG_CRYPTO_AES_ARM=y
CONFIG_CRC7=y
CONFIG_FONTS=y
CONFIG_FONT_8x8=y
CONFIG_FONT_8x16=y
CONFIG_PRINTK_TIME=y
CONFIG_DYNAMIC_DEBUG=y
CONFIG_MAGIC_SYSRQ=y
CONFIG_RCU_CPU_STALL_TIMEOUT=60
```
