// SPDX-License-Identifier: GPL-2.0-only
/*
 * Device tree for the NI VB-8012 (device code 0x76F6).
 *
 * Copyright (C) 2013-2026 National Instruments
 */

/dts-v1/;
/include/ "ni-lci.dtsi"

/ {
	model = "NI VB-8012";
};
