// SPDX-License-Identifier: GPL-2.0-only
/*
 * Device tree for the Digilent ADP5470 (device code 0x7ABA).
 *
 * Copyright (C) 2013-2026 National Instruments
 */

/dts-v1/;
/include/ "ni-lci.dtsi"

/ {
	model = "Digilent ADP5470";
};

&gem0 {
	status = "okay";
};
