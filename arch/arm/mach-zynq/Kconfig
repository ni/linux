## arch/arm/mach-zynq/Kconfig
```kconfig
# SPDX-License-Identifier: GPL-2.0
config ARCH_ZYNQ
	bool "Xilinx Zynq ARM Cortex A9 Platform"
	depends on ARCH_MULTI_V7
	select ARCH_HAS_RESET_CONTROLLER
	select ARM_AMBA
	select ARM_GIC
	select ARM_GLOBAL_TIMER
	select CADENCE_TTC_TIMER
	select HAVE_ARM_SCU if SMP
	select HAVE_ARM_TWD if SMP
	select MFD_SYSCON
	select PINCTRL
	select PINCTRL_ZYNQ
	select SOC_BUS
	help
	  Support for Xilinx Zynq ARM Cortex A9 Platform

config NI_ZYNQ_GIC_LEGACY_IRQDOMAIN
	bool "Use fixed GIC IRQ numbers on NI Zynq targets"
	depends on ARCH_ZYNQ
	help
	  Create fixed Linux IRQ mappings for the primary GIC so that its
	  Linux IRQ numbers equal the corresponding GIC hardware IRQ numbers.
	  This preserves compatibility with NI drivers that use fixed IRQs.
	  Enable this only on NI Zynq systems that require the legacy IRQ
	  numbering contract.

config NI_LEGACY_ARM_CACHEINFO_SIZE
	bool "Use legacy cache size units on NI ARM targets"
	depends on ARCH_ZYNQ
	help
	  Report CPU cache sizes in bytes through sysfs instead of using the
	  generic cacheinfo K suffix. This preserves compatibility with released
	  NI ARM software that expects the legacy NI kernel representation.
	  Enable this only for systems that require this compatibility behavior.
```
